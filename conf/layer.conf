## conf/layer.conf
```bitbake
# We have a conf and classes directory, add to BBPATH
BBPATH .= ":${LAYERDIR}"

# We have recipes-* directories, add to BBFILES
BBFILES += "${LAYERDIR}/recipes-*/*/*.bb \
    ${LAYERDIR}/recipes-*/*.bb \
    ${LAYERDIR}/recipes-*/*.bbappend \
    ${LAYERDIR}/recipes-*/*/*.bb \
    ${LAYERDIR}/recipes-*/*/*.bbappend \
    ${LAYERDIR}/recipes-*/*/*/*.bb \
    ${LAYERDIR}/recipes-*/*/*/*.bbappend"

BBFILES_DYNAMIC += " \
    qt5-layer:${LAYERDIR}/dynamic-layers/qt5-layer/*/*.bb \
    qt5-layer:${LAYERDIR}/dynamic-layers/qt5-layer/*/*.bbappend \
    virtualization-layer:${LAYERDIR}/dynamic-layers/virtualization-layer/*/*.bb \
    virtualization-layer:${LAYERDIR}/dynamic-layers/virtualization-layer/*/*.bbappend \
"

BBFILE_COLLECTIONS += "asus-renesas"
BBFILE_PATTERN_asus-renesas = "^${LAYERDIR}/"
BBFILE_PRIORITY_asus-renesas = "15"
LAYERSERIES_COMPAT_asus-renesas = "dunfell"

HOSTTOOLS += "xz"
```

## conf/machine/rzfive-tinker-v.conf
```bitbake
#@TYPE: Machine
#@NAME: smarc-rzfive machine
#@DESCRIPTION: RZ/Five SMARC platform

SOC_FAMILY = "r9a07g043f"
require conf/machine/include/asus-common.inc
require conf/machine/include/cip-core.inc
require conf/machine/include/riscv/tune-rz-rv64.inc

UBOOT_CONFIG ??= "smarc-rzfive"
UBOOT_CONFIG[smarc-rzfive] = "tinker_v_defconfig"

# flash writer
EXTRA_IMAGEDEPENDS += " flash-writer"

# Supported devicetree
KERNEL_DEVICETREE = " \
    renesas/r9a07g043f01-tinker-v.dtb \
"

PREFERRED_PROVIDER_u-boot = "u-boot-asus-renesas"
PREFERRED_PROVIDER_virtual/bootloader = "u-boot-asus-renesas"
PREFERRED_PROVIDER_virtual/kernel = "linux-asus-renesas"
PREFERRED_PROVIDER_linux-libc-headers = "linux-libc-headers-asus"

CORE_IMAGE_EXTRA_INSTALL += " \
    asus-overlay \
    phytool \
    spidev-test \
    can-utils \
    android-tools \
    lsof \
    openssh \
    vim \
    stressapptest \
    memtester \
    bc \
    python3 \
    python3-pip \
    curl \
    packagegroup-core-buildessential \
"
```
